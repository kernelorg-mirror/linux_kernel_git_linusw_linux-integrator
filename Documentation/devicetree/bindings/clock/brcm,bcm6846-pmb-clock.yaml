## Documentation/devicetree/bindings/clock/brcm,bcm6846-pmb-clock.yaml
```yaml
# SPDX-License-Identifier: (GPL-2.0-only OR BSD-2-Clause)
%YAML 1.2
---
$id: http://devicetree.org/schemas/clock/brcm,bcm6846-pmb-clock.yaml#
$schema: http://devicetree.org/meta-schemas/core.yaml#

title: Broadcom BCM6846 PMB clocks

maintainers:
  - Linus Walleij <linusw@kernel.org>

description:
  The Processor Monitor Bus (PMB) provides access to the RDP and BIU PLL
  outputs, the Runner clock, the crystal output, the PVTMON acquisition
  clock and the clock gates in block power-control zones. Clock indices
  are defined in dt-bindings/clock/brcm,bcm6846-pmb.h.
  The PLLs and crystal output use a 50 MHz reference clock.
  Zone clocks require their associated blocks to be powered.

properties:
  compatible:
    const: brcm,bcm6846-pmb-clock

  clocks:
    maxItems: 1

  clock-names:
    const: ref

  '#clock-cells':
    const: 1

required:
  - compatible
  - clocks
  - clock-names
  - '#clock-cells'

additionalProperties: false
```

## Documentation/devicetree/bindings/hwmon/brcm,bcm6846-pmb-pvtmon.yaml
```yaml
# SPDX-License-Identifier: (GPL-2.0-only OR BSD-2-Clause)
%YAML 1.2
---
$id: http://devicetree.org/schemas/hwmon/brcm,bcm6846-pmb-pvtmon.yaml#
$schema: http://devicetree.org/meta-schemas/core.yaml#

title: Broadcom BCM6846 PMB process, voltage and temperature monitor

maintainers:
  - Linus Walleij <linusw@kernel.org>

description:
  The process, voltage and temperature monitor (PVTMON) is a child of
  the Processor Monitor Bus (PMB) controller and uses its indirect
  register interface. It measures die temperature and seven voltages,
  including a diagnostic test input.

allOf:
  - $ref: /schemas/thermal/thermal-sensor.yaml#

properties:
  compatible:
    const: brcm,bcm6846-pmb-pvtmon

  clocks:
    maxItems: 1
    description: PVTMON acquisition clock

  resets:
    maxItems: 1
    description: PVTMON analog-acquisition reset

  '#thermal-sensor-cells':
    const: 0

required:
  - compatible
  - clocks
  - resets
  - '#thermal-sensor-cells'

additionalProperties: false
```

## Documentation/devicetree/bindings/mfd/brcm,bcm6846-pmc.yaml
```yaml
# SPDX-License-Identifier: (GPL-2.0-only OR BSD-2-Clause)
%YAML 1.2
---
$id: http://devicetree.org/schemas/mfd/brcm,bcm6846-pmc.yaml#
$schema: http://devicetree.org/meta-schemas/core.yaml#

title: Broadcom BCM6846 Power Management Controller

maintainers:
  - Linus Walleij <linusw@kernel.org>

description:
  The third generation Power Management Controller (PMC3) contains several
  register banks. This binding describes the Processor Monitor Bus (PMB)
  interface within Procmon. The PMB child owns its register bank. The parent
  provides address translation and does not own a register bank.

properties:
  compatible:
    items:
      - const: brcm,bcm6846-pmc
      - const: simple-mfd

  ranges:
    maxItems: 1

  "#address-cells":
    const: 1

  "#size-cells":
    const: 1

patternProperties:
  '^bus@[0-9a-f]+$':
    $ref: /schemas/soc/bcm/brcm,bcm6846-pmb.yaml#
    description: PMB configuration, keyhole and address mapping registers

required:
  - compatible
  - ranges
  - '#address-cells'
  - '#size-cells'

additionalProperties: false

examples:
  - |
    #include <dt-bindings/clock/brcm,bcm6846-pmb.h>
    #include <dt-bindings/reset/brcm,bcm6846-pmb.h>

    system-controller@ffb00000 {
        /* Broadcom BCM6846 Power Management Controller complex */
        compatible = "brcm,bcm6846-pmc", "simple-mfd";
        ranges = <0x0 0xffb00000 0x21000>;
        #address-cells = <1>;
        #size-cells = <1>;

        /* Called PMB Processor Monitor Bus in vendor tree */
        bus@20100 {
            compatible = "brcm,bcm6846-pmb";
            reg = <0x20100 0x200>;

            pmb_clk: clock-controller {
                compatible = "brcm,bcm6846-pmb-clock";
                clocks = <&osc50m>;
                clock-names = "ref";
                #clock-cells = <1>;
            };

            pmb_reset: reset-controller {
                compatible = "brcm,bcm6846-pmb-reset";
                #reset-cells = <1>;
            };

            hwmon {
                compatible = "brcm,bcm6846-pmb-pvtmon";
                clocks = <&pmb_clk BCM6846_CLK_PVTMON>;
                resets = <&pmb_reset BCM6846_RESET_PVTMON>;
                #thermal-sensor-cells = <0>;
            };
        };
    };
```

## Documentation/devicetree/bindings/power/brcm,bcm6846-pmb-power.yaml
```yaml
# SPDX-License-Identifier: (GPL-2.0-only OR BSD-2-Clause)
%YAML 1.2
---
$id: http://devicetree.org/schemas/power/brcm,bcm6846-pmb-power.yaml#
$schema: http://devicetree.org/meta-schemas/core.yaml#

title: Broadcom BCM6846 Processor Monitor Bus power controller

maintainers:
  - Linus Walleij <linusw@kernel.org>

description: |
  The power controller is a child of the Processor Monitor Bus (PMB)
  controller and accesses BPCM power zones through the parent regmap.
  A domain includes all power zones of a block. The XRDP domain groups
  XRDP, its three Runner cores and WAN, matching the vendor power sequence.

  Domain IDs are defined in dt-bindings/power/brcm,bcm6846-pmb.h:
    BCM6846_PD_PERIPH: peripheral block (bus 0, device 0, four zones)
    BCM6846_PD_MEMC: memory controller (bus 1, device 8, one zone)
    BCM6846_PD_USB20: USB 2.0 (bus 1, device 10, four zones)
    BCM6846_PD_XRDP: XRDP (bus 1, device 12, three zones), Runner cores
      (bus 1, devices 14, 15 and 16, one zone each) and WAN
      (bus 1, device 11, three zones)
    BCM6846_PD_PCIE0: PCIe 0 (bus 0, device 18, one zone)
    BCM6846_PD_PCIE1: PCIe 1 (bus 0, device 19, one zone)

  Peripheral and memory domains remain powered because they provide
  resources required for system operation. CPU and PLL blocks use different
  register layouts and are outside the scope of this provider.

properties:
  compatible:
    const: brcm,bcm6846-pmb-power

  '#power-domain-cells':
    const: 1
    description: Power domain ID from dt-bindings/power/brcm,bcm6846-pmb.h

required:
  - compatible
  - '#power-domain-cells'

additionalProperties: false
```

## Documentation/devicetree/bindings/reset/brcm,bcm6846-pmb-reset.yaml
```yaml
# SPDX-License-Identifier: (GPL-2.0-only OR BSD-2-Clause)
%YAML 1.2
---
$id: http://devicetree.org/schemas/reset/brcm,bcm6846-pmb-reset.yaml#
$schema: http://devicetree.org/meta-schemas/core.yaml#

title: Broadcom BCM6846 Processor Monitor Bus reset controller

maintainers:
  - Linus Walleij <linusw@kernel.org>

description:
  The reset controller is a child of the Processor Monitor Bus (PMB)
  controller and uses its indirect register interface.

  Each reset specifier identifies a logical reset group, which may span
  several blocks that must be reset together.

properties:
  compatible:
    const: brcm,bcm6846-pmb-reset

  '#reset-cells':
    const: 1
    description: Reset group ID from dt-bindings/reset/brcm,bcm6846-pmb.h

required:
  - compatible
  - '#reset-cells'

additionalProperties: false
```

## Documentation/devicetree/bindings/soc/bcm/brcm,bcm6846-pmb.yaml
```yaml
# SPDX-License-Identifier: (GPL-2.0-only OR BSD-2-Clause)
%YAML 1.2
---
$id: http://devicetree.org/schemas/soc/bcm/brcm,bcm6846-pmb.yaml#
$schema: http://devicetree.org/meta-schemas/core.yaml#

title: Broadcom BCM6846 Processor Monitor Bus

maintainers:
  - Linus Walleij <linusw@kernel.org>

description:
  The Processor Monitor Bus (PMB) connects the third generation Power
  Management Controller (PMC3) to the control registers of SoC blocks.
  The controller provides configuration, arbitration and four keyhole
  interfaces for indirect register access, including the reset registers
  of SoC blocks.

  The PMB interface is part of Procmon within the PMC complex and is
  described by its bus child node. The register bank starts at the
  PMB configuration register, not at the beginning of Procmon.

  Child nodes describe the clock and reset controllers and the process,
  voltage and temperature monitor (PVTMON), accessed through the shared
  PMB interface.

properties:
  compatible:
    const: brcm,bcm6846-pmb

  reg:
    maxItems: 1
    description: PMB configuration, keyhole and address mapping registers

  clock-controller:
    type: object
    $ref: /schemas/clock/brcm,bcm6846-pmb-clock.yaml#

  reset-controller:
    type: object
    $ref: /schemas/reset/brcm,bcm6846-pmb-reset.yaml#

  hwmon:
    type: object
    $ref: /schemas/hwmon/brcm,bcm6846-pmb-pvtmon.yaml#

required:
  - compatible
  - reg
  - clock-controller
  - reset-controller
  - hwmon

additionalProperties: false

examples:
  - |
    #include <dt-bindings/clock/brcm,bcm6846-pmb.h>
    #include <dt-bindings/reset/brcm,bcm6846-pmb.h>

    /* Called PMB Processor Monitor Bus in vendor tree */
    bus@ffb20100 {
        compatible = "brcm,bcm6846-pmb";
        reg = <0xffb20100 0x200>;

        pmb_clk: clock-controller {
            compatible = "brcm,bcm6846-pmb-clock";
            clocks = <&osc50m>;
            clock-names = "ref";
            #clock-cells = <1>;
        };

        pmb_reset: reset-controller {
            compatible = "brcm,bcm6846-pmb-reset";
            #reset-cells = <1>;
        };

        hwmon {
            compatible = "brcm,bcm6846-pmb-pvtmon";
            clocks = <&pmb_clk BCM6846_CLK_PVTMON>;
            resets = <&pmb_reset BCM6846_RESET_PVTMON>;
            #thermal-sensor-cells = <0>;
        };
    };
```

## Documentation/devicetree/bindings/sound/qcom,lpass-cpu.txt
```
* Qualcomm Technologies LPASS CPU DAI

This node models the Qualcomm Technologies Low-Power Audio SubSystem (LPASS)
digital audio interface.

This hardware block contains a Qualcomm Hexagon QDSP6 variant with its own
memory and a set of clock generators for the subsystem itself and the different
I2S and PCM channels. The idea is that this subsystem should be able to stream
audio autonomously while the rest of the system goes into suspend.

The block has a separate binding for its clock generators, see
clock/qcom,lcc.txt for details.

The block has a separate binding for its audio DSP, see
remoteproc/qcom,adsp.txt for details.

Required properties:

- compatible		: one of
				* "qcom,lpass-cpu"
				* "qcom,apq8016-lpass-cpu"
				* "qcom,msm8660-lpass-cpu"
- clocks		: Must contain an entry for each entry in clock-names.
- clock-names		: required clocks for "qcom,lpass-cpu":
				* "ahbix-clk"
				* "mi2s-osr-clk"
				* "mi2s-bit-clk"
			: required clocks for "qcom,lpass-cpu-apq8016"
				* "ahbix-clk"
				* "mi2s-bit-clk0"
				* "mi2s-bit-clk1"
				* "mi2s-bit-clk2"
				* "mi2s-bit-clk3"
				* "pcnoc-mport-clk"
				* "pcnoc-sway-clk"
			: required clocks for "qcom,lpass-cpu-msm8660"
				* "mi2s-osr-clk"
				* "mi2s-bit-clk"
				* "codec-i2s-mic-osr-clk"
				* "codec-i2s-mic-bit-clk"
				* "spare-i2s-mic-osr-clk"
				* "spare-i2s-mic-bit-clk"
				* "codec-i2s-spkr-osr-clk"
				* "codec-i2s-spkr-bit-clk"
				* "spare-i2s-spkr-osr-clk"
				* "spare-i2s-spkr-bit-clk"

- interrupts		: Must contain an entry for each entry in
			  interrupt-names.
- interrupt-names	: A list which must include the following entries:
				* "lpass-irq-lpaif"
- pinctrl-N		: One property must exist for each entry in
			  pinctrl-names.  See ../pinctrl/pinctrl-bindings.txt
			  for details of the property values.
- pinctrl-names		: Must contain a "default" entry.
- reg			: Must contain an address for each entry in reg-names.
- reg-names		: A list which must include the following entries:
				* "lpass-lpaif"
- #address-cells	: Must be 1
- #size-cells		: Must be 0



Optional properties:

- qcom,adsp		: Phandle for the audio DSP node

By default, the driver uses up to 4 MI2S SD lines, for a total of 8 channels.
The SD lines to use can be configured by adding subnodes for each of the DAIs.

Required properties for each DAI (represented by a subnode):
- reg			: Must be one of the DAI IDs
			  (usually part of dt-bindings header)
- qcom,playback-sd-lines: List of serial data lines to use for playback
			  Each SD line should be represented by a number from 0-3.
- qcom,capture-sd-lines	: List of serial data lines to use for capture
			  Each SD line should be represented by a number from 0-3.

Note that adding a subnode changes the default to "no lines configured",
so both playback and capture lines should be configured when a subnode is added.

Example:

lpass@28100000 {
	compatible = "qcom,lpass-cpu";
	clocks = <&lcc AHBIX_CLK>, <&lcc MI2S_OSR_CLK>, <&lcc MI2S_BIT_CLK>;
	clock-names = "ahbix-clk", "mi2s-osr-clk", "mi2s-bit-clk";
	interrupts = <0 85 1>;
	interrupt-names = "lpass-irq-lpaif";
	pinctrl-names = "default", "idle";
	pinctrl-0 = <&mi2s_default>;
	pinctrl-1 = <&mi2s_idle>;
	reg = <0x28100000 0x10000>;
	reg-names = "lpass-lpaif";
	qcom,adsp = <&adsp>;

	#address-cells = <1>;
	#size-cells = <0>;

	/* Optional to set different MI2S SD lines */
	dai@3 {
		reg = <MI2S_QUATERNARY>;
		qcom,playback-sd-lines = <0 1>;
	};
};
```

## arch/arm/configs/bcm53xx_defconfig
```kconfig
CONFIG_KERNEL_XZ=y
CONFIG_NO_HZ_FULL=y
CONFIG_HIGH_RES_TIMERS=y
CONFIG_PREEMPT=y
CONFIG_NAMESPACES=y
CONFIG_EMBEDDED=y
CONFIG_ARCH_BCM=y
CONFIG_ARCH_BCM_5301X=y
CONFIG_ARCH_BCM_53573=y
CONFIG_SMP=y
CONFIG_NR_CPUS=2
CONFIG_HIGHMEM=y
CONFIG_ARM_APPENDED_DTB=y
CONFIG_CMDLINE="console=ttyS0,115200"
CONFIG_NET=y
CONFIG_UNIX=y
CONFIG_INET=y
CONFIG_NET_DSA=y
CONFIG_CFG80211=y
CONFIG_MAC80211=y
CONFIG_PCI=y
# CONFIG_PCIE_IPROC_PLATFORM is not set
CONFIG_BCM47XX_NVRAM=y
CONFIG_BCM47XX_SPROM=y
CONFIG_MTD=y
CONFIG_MTD_BCM47XX_PARTS=y
CONFIG_MTD_PARSER_TRX=y
CONFIG_MTD_PARTITIONED_MASTER=y
CONFIG_MTD_JEDECPROBE=y
CONFIG_MTD_RAW_NAND=y
CONFIG_MTD_NAND_BRCMNAND=y
CONFIG_MTD_SPI_NOR=y
CONFIG_MTD_UBI=y
CONFIG_NETDEVICES=y
CONFIG_B53=y
CONFIG_BGMAC_BCMA=y
CONFIG_BROADCOM_PHY=y
CONFIG_MDIO_BUS_MUX_MMIOREG=y
CONFIG_B43=y
CONFIG_BRCMFMAC=y
CONFIG_BRCMFMAC_PCIE=y
CONFIG_KEYBOARD_GPIO=y
CONFIG_SERIAL_8250=y
CONFIG_SERIAL_8250_CONSOLE=y
CONFIG_SERIAL_OF_PLATFORM=y
CONFIG_SPI=y
CONFIG_SPI_GPIO=y
# CONFIG_PTP_1588_CLOCK is not set
# CONFIG_PINCTRL_IPROC_GPIO is not set
CONFIG_GPIO_74X164=y
CONFIG_THERMAL=y
CONFIG_WATCHDOG=y
CONFIG_BCM47XX_WDT=y
CONFIG_BCMA_HOST_SOC=y
# CONFIG_BCMA_SFLASH is not set
CONFIG_BCMA_DRIVER_GMAC_CMN=y
CONFIG_BCMA_DRIVER_GPIO=y
CONFIG_BCMA_DEBUG=y
CONFIG_MFD_SYSCON=y
CONFIG_REGULATOR=y
CONFIG_REGULATOR_FIXED_VOLTAGE=y
CONFIG_HID_A4TECH=y
CONFIG_HID_BELKIN=y
CONFIG_HID_CHERRY=y
CONFIG_HID_CYPRESS=y
CONFIG_HID_EZKEY=y
CONFIG_HID_ITE=y
CONFIG_HID_KENSINGTON=y
CONFIG_HID_REDRAGON=y
CONFIG_HID_MICROSOFT=y
CONFIG_HID_MONTEREY=y
CONFIG_USB=y
CONFIG_USB_XHCI_HCD=y
CONFIG_USB_XHCI_PLATFORM=y
CONFIG_USB_EHCI_HCD=y
CONFIG_USB_OHCI_HCD=y
CONFIG_USB_HCD_BCMA=y
CONFIG_USB_HCD_SSB=y
CONFIG_NEW_LEDS=y
CONFIG_LEDS_CLASS=y
CONFIG_LEDS_GPIO=y
CONFIG_LEDS_TRIGGERS=y
CONFIG_LEDS_TRIGGER_HEARTBEAT=y
# CONFIG_CLK_BCM_NS2 is not set
# CONFIG_CLK_BCM_SR is not set
CONFIG_EXTCON=y
CONFIG_PWM=y
CONFIG_PHY_BCM_NS_USB2=y
CONFIG_PHY_BCM_NS_USB3=y
# CONFIG_PHY_NS2_PCIE is not set
# CONFIG_PHY_NS2_USB_DRD is not set
# CONFIG_PHY_BRCM_SATA is not set
# CONFIG_PHY_BCM_SR_PCIE is not set
CONFIG_NVMEM_BRCM_NVRAM=y
CONFIG_EXT4_FS=y
CONFIG_TMPFS=y
CONFIG_UBIFS_FS=y
# CONFIG_FTRACE is not set
CONFIG_DEBUG_USER=y
```
