## Documentation/devicetree/bindings/mfd/brcm,bcm6846-pmc.yaml
```yaml
# SPDX-License-Identifier: (GPL-2.0-only OR BSD-2-Clause)
%YAML 1.2
---
$id: http://devicetree.org/schemas/mfd/brcm,bcm6846-pmc.yaml#
$schema: http://devicetree.org/meta-schemas/core.yaml#

title: Broadcom BCM6846 Power Management Controller

maintainers:
  - Linus Walleij <linusw@kernel.org>

description:
  The third generation Power Management Controller (PMC3) contains several
  register banks. This binding describes the Power Management Bus (PMB)
  interface within Procmon. The PMB child owns its register bank. The parent
  provides address translation and does not own a register bank.

properties:
  compatible:
    items:
      - const: brcm,bcm6846-pmc
      - const: simple-mfd

  ranges:
    maxItems: 1

  "#address-cells":
    const: 1

  "#size-cells":
    const: 1

patternProperties:
  '^bus@[0-9a-f]+$':
    type: object
    description:
      The Power Management Bus (PMB) connects the third generation Power
      Management Controller (PMC3) to the control registers of miscellaneous
      independent hardware blocks.

      The controller provides configuration, arbitration and four keyhole
      interfaces for indirect register access.

      Child nodes describe independent hardware blocks accessed over the PMB.
      These provide global resources and even resources for each other.

    properties:
      compatible:
        const: brcm,bcm6846-pmb

      reg:
        maxItems: 1
        description: PMB configuration, keyhole and address mapping registers

      power-controller:
        type: object
        description: |
          The power controller is a child of the Power Management Bus (PMB)
          controller and accesses BPCM power zones through the parent regmap.
          A domain includes all power zones of a block. The XRDP domain groups
          XRDP, its three Runner cores and WAN, matching the vendor power sequence.

          Domain IDs are defined in dt-bindings/power/brcm,bcm6846-pmb.h:
            BCM6846_PD_PERIPH: peripheral block (bus 0, device 0, four zones)
            BCM6846_PD_MEMC: memory controller (bus 1, device 8, one zone)
            BCM6846_PD_USB20: USB 2.0 (bus 1, device 10, four zones)
            BCM6846_PD_XRDP: XRDP (bus 1, device 12, three zones), Runner cores
              (bus 1, devices 14, 15 and 16, one zone each) and WAN
              (bus 1, device 11, three zones)
            BCM6846_PD_PCIE0: PCIe 0 (bus 0, device 18, one zone)
            BCM6846_PD_PCIE1: PCIe 1 (bus 0, device 19, one zone)

          Peripheral and memory domains remain powered because they provide
          resources required for system operation. CPU and PLL blocks use different
          register layouts and are outside the scope of this provider.

        properties:
          compatible:
            const: brcm,bcm6846-pmb-power

          '#power-domain-cells':
            const: 1
            description: Power domain ID from dt-bindings/power/brcm,bcm6846-pmb.h

        required:
          - compatible
          - '#power-domain-cells'

        additionalProperties: false

      clock-controller:
        type: object
        description:
          The Power Management Bus (PMB) provides access to the RDP and BIU PLL
          outputs, the Runner clock, the crystal output, the PVTMON acquisition
          clock and the clock gates in block power-control zones. Clock indices
          are defined in dt-bindings/clock/brcm,bcm6846-pmb.h.
          The PLLs and crystal output use a 50 MHz reference clock.
          Zone clocks require their associated blocks to be powered.

        properties:
          compatible:
            const: brcm,bcm6846-pmb-clock

          clocks:
            maxItems: 1

          clock-names:
            const: ref

          '#clock-cells':
            const: 1

        required:
          - compatible
          - clocks
          - clock-names
          - '#clock-cells'

        additionalProperties: false

      reset-controller:
        type: object
        description:
          The reset controller is a child of the Power Management Bus (PMB)
          controller and uses its indirect register interface.

          Each reset specifier identifies a logical reset group, which may span
          several blocks that must be reset together.

        properties:
          compatible:
            const: brcm,bcm6846-pmb-reset

          '#reset-cells':
            const: 1
            description: Reset group ID from dt-bindings/reset/brcm,bcm6846-pmb.h

        required:
          - compatible
          - '#reset-cells'

        additionalProperties: false

      hwmon:
        type: object
        description:
          The process, voltage and temperature monitor (PVTMON) is a child of
          the Power Management Bus (PMB) controller and uses its indirect
          register interface. It measures die temperature and seven voltages,
          including a diagnostic test input.

        allOf:
          - $ref: /schemas/thermal/thermal-sensor.yaml#

        properties:
          compatible:
            const: brcm,bcm6846-pmb-pvtmon

          clocks:
            maxItems: 1
            description: PVTMON acquisition clock

          resets:
            maxItems: 1
            description: PVTMON analog-acquisition reset

          '#thermal-sensor-cells':
            const: 0

        required:
          - compatible
          - clocks
          - resets
          - '#thermal-sensor-cells'

        unevaluatedProperties: false

    required:
      - compatible
      - reg
      - power-controller
      - clock-controller
      - reset-controller
      - hwmon

    additionalProperties: false

required:
  - compatible
  - ranges
  - '#address-cells'
  - '#size-cells'

additionalProperties: false

examples:
  - |
    #include <dt-bindings/clock/brcm,bcm6846-pmb.h>
    #include <dt-bindings/reset/brcm,bcm6846-pmb.h>

    system-controller@ffb00000 {
        /* Broadcom BCM6846 Power Management Controller complex */
        compatible = "brcm,bcm6846-pmc", "simple-mfd";
        ranges = <0x0 0xffb00000 0x21000>;
        #address-cells = <1>;
        #size-cells = <1>;

        /* Power Management Bus */
        bus@20100 {
            compatible = "brcm,bcm6846-pmb";
            reg = <0x20100 0x200>;

            pmb_clk: clock-controller {
                compatible = "brcm,bcm6846-pmb-clock";
                clocks = <&osc50m>;
                clock-names = "ref";
                #clock-cells = <1>;
            };

            hwmon {
                compatible = "brcm,bcm6846-pmb-pvtmon";
                clocks = <&pmb_clk BCM6846_CLK_PVTMON>;
                resets = <&pmb_reset BCM6846_RESET_PVTMON>;
                #thermal-sensor-cells = <0>;
            };

            power-controller {
                compatible = "brcm,bcm6846-pmb-power";
                #power-domain-cells = <1>;
            };

            pmb_reset: reset-controller {
                compatible = "brcm,bcm6846-pmb-reset";
                #reset-cells = <1>;
            };
        };
    };
```

## drivers/net/wireless/ralink/inic/Kconfig
```kconfig
# SPDX-License-Identifier: GPL-2.0-only
config RALINK_INIC
	tristate "Ralink RT2880 iNIC PCI support"
	depends on PCI && CFG80211
	select FW_LOADER
	select CRC32
	help
	  Experimental FullMAC driver for the RT2880 PCI intelligent NIC
	  (1814:0801). Supports one 2.4 GHz access point using the original
	  PCI AP firmware. This is a different device from the RT2800
	  supported by rt2x00.

	  Requires ralink/rt2880-inic-ap.bin in /lib/firmware.

	  To compile this driver as a module, choose M here. The module will
	  be called ralink-inic.
```
