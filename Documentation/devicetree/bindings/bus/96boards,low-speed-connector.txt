## Documentation/devicetree/bindings/bus/96boards,low-speed-connector.txt
```
96Boards Low Speed Connectors

The 96Boards connectors represent a non-dicoverable Low Speed (LS)
and High Speed (HS) external bus on the 96Board development
boards. Each 96Board presents both of these connectors.

The Low Speed (LS) connector is a 40 pin 2x20 female pin header:
- Power
- Two buttons: power and reset
- 2 x UART one optional with just RX/TX, one required with modem
  CTS/RTS
- 2 x I2C
- 1 x SPI
- 1 x I2S (audio)
- 12 x GPIO lines named GPIO-A thru GPIO-L

Further details on the electronics and signals are available in
"96Boards Consumer Edition, Low Cost Hardware Platform Specification"
As of writing version 1.0, January 2015.

Required properties:

- compatible: shall be "96boards,low-speed-connector"
- i2c0: phandle to the I2C0 bus
- i2c1: phandle to the I2C1 bus
- spi: phandle to the SPI bus
- gpios: a list of phandles to the GPIOs connected to the
  connector. The handles need to be uniformly specified with the
  0 flag as the connector is not the end consumer.

Example:

lscon: connector {
	compatible = "96boards,low-speed-connector";
	i2c0 = <&i2csw_0>;
	i2c1 = <&i2csw_1>;
	spi = <&spi0>;
	gpios = <&gpio 36 0>, /* GPIO-A */
	        <&gpio 37 0>, /* GPIO-B */
		<&gpio 39 0>, /* GPIO-C */
		<&gpio 40 0>, /* GPIO-D */
		<&gpio 44 0>, /* GPIO-E */
		<&gpio 45 0>, /* GPIO-F */
		<&gpio 78 0>, /* GPIO-G */
		<&gpio 79 0>, /* GPIO-H */
		<&gpio 80 0>, /* GPIO-I */
		<&gpio 81 0>, /* GPIO-J */
		<&gpio 82 0>, /* GPIO-K */
		<&gpio 83 0>; /* GPIO-L */
};
```

## drivers/bus/daughterboards/Kconfig
```kconfig
# SPDX-License-Identifier: GPL-2.0
#
# Non-discoverable daughterboards

menuconfig DAUGHTERBOARDS
	bool "Non-discoverable daughterboards"
	help
	  These bus drivers deal with non-discoverable daughterboards,
	  which means daughterboards (plug-in complex logic circuit
	  boards) that can not reliably be discovered by software.
	  The physical connector is defined for the host hardware,
	  but we need to indicate what is on it at runtime using
	  sysfs.

if DAUGHTERBOARDS

menuconfig 96BOARDS_MEZZANINES
	bool "96boards mezzanine boards"

if 96BOARDS_MEZZANINES

config 96BOARDS_LS_CONNECTOR
	bool "96boards low speed connector driver"
	depends on OF
	depends on I2C
	depends on SPI_MASTER
	depends on GPIOLIB
	help
	 Driver for the 96boards low speed connector

config 96BOARDS_SECURE96
	bool "96boards Secure96 board driver"
	depends on 96BOARDS_LS_CONNECTOR
	select NEW_LEDS
	select LEDS_CLASS
	select LEDS_GPIO
	select EEPROM_AT24
	select CRYPTO_HW
	select CRYPTO_DEV_ATMEL_ECC
	select HW_RANDOM
	select TCG_TPM
	select HW_RANDOM_TPM
	select TCG_TIS
	select TCG_TIS_SPI
	help
	 Driver for the 96boards Secure96 mezzanine

endif # 96BOARDS_MEZZANINES

endif # DAUGHTERBOARDS
```
